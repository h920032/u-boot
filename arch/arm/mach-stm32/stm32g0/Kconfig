## arch/arm/mach-stm32/stm32g0/Kconfig
```kconfig
if STM32G0

config TARGET_STM32G071_DISCOVERY
	bool "STM32F429 Discovery board"

source "board/st/stm32g071-discovery/Kconfig"

endif
```

## board/st/stm32g071-discovery/Kconfig
```kconfig
if TARGET_STM32F429_DISCOVERY

config SYS_BOARD
	default "stm32g071-discovery"

config SYS_VENDOR
	default "st"

config SYS_SOC
	default "stm32g0"

config SYS_CONFIG_NAME
	default "stm32g071-discovery"

endif
```
